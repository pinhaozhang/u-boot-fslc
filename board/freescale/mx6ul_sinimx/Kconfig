## board/freescale/mx6ul_sinimx/Kconfig
```kconfig
if TARGET_MX6UL_SINIMX

config SYS_BOARD
	default "mx6ul_sinimx"

config SYS_VENDOR
	default "freescale"

config SYS_CONFIG_NAME
	default "mx6ul_sinimx"

endif
```
