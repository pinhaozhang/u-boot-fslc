// SPDX-License-Identifier: GPL-2.0
//
// Copyright (C) 2015 Freescale Semiconductor, Inc.

/dts-v1/;

#include "imx6ul.dtsi"
#include "imx6ul-sinimx.dtsi"

/ {
	model = "Sinimx i.MX6 UltraLite Development Board";
	compatible = "fsl,imx6ul-sinimx", "fsl,imx6ul";
};
